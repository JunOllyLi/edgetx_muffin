//
// WARNING: DO NOT EDIT THIS FILE
//   This file has been generated from the target's JSON hardware description
//

typedef struct {
    uint32_t bit; // bit in uint32_t
    uint32_t xor_bit; // for active low/high
    uint32_t key_code_bit;
} mcp_key_map_t;

static mcp_key_map_t key_mapping[] = {
    {
        .bit = (1 << ((MCP_PORT_2 - 1) * 8 + GPIO_PIN_6)),
        .xor_bit = (1 << ((MCP_PORT_2 - 1) * 8 + GPIO_PIN_6)),
        .key_code_bit = (1 << KEY_EXIT)
    },
    {
        .bit = (1 << ((MCP_PORT_2 - 1) * 8 + GPIO_PIN_4)),
        .xor_bit = (1 << ((MCP_PORT_2 - 1) * 8 + GPIO_PIN_4)),
        .key_code_bit = (1 << KEY_ENTER)
    },
    {
        .bit = (1 << ((MCP_PORT_3 - 1) * 8 + GPIO_PIN_3)),
        .xor_bit = (1 << ((MCP_PORT_3 - 1) * 8 + GPIO_PIN_3)),
        .key_code_bit = (1 << KEY_UP)
    },
    {
        .bit = (1 << ((MCP_PORT_3 - 1) * 8 + GPIO_PIN_1)),
        .xor_bit = (1 << ((MCP_PORT_3 - 1) * 8 + GPIO_PIN_1)),
        .key_code_bit = (1 << KEY_DOWN)
    },
    {
        .bit = (1 << ((MCP_PORT_3 - 1) * 8 + GPIO_PIN_0)),
        .xor_bit = (1 << ((MCP_PORT_3 - 1) * 8 + GPIO_PIN_0)),
        .key_code_bit = (1 << KEY_MODEL)
    },
};

static mcp_key_map_t trim_mapping[] = {
    {
        .bit = (1 << ((MCP_PORT_3 - 1) * 8 + GPIO_PIN_5)),
        .xor_bit = (1 << ((MCP_PORT_3 - 1) * 8 + GPIO_PIN_5)),
        .key_code_bit = (1 << 0)
    },
    {
        .bit = (1 << ((MCP_PORT_3 - 1) * 8 + GPIO_PIN_6)),
        .xor_bit = (1 << ((MCP_PORT_3 - 1) * 8 + GPIO_PIN_6)),
        .key_code_bit = (1 << 1)
    },
    {
        .bit = (1 << ((MCP_PORT_1 - 1) * 8 + GPIO_PIN_7)),
        .xor_bit = (1 << ((MCP_PORT_1 - 1) * 8 + GPIO_PIN_7)),
        .key_code_bit = (1 << 2)
    },
    {
        .bit = (1 << ((MCP_PORT_1 - 1) * 8 + GPIO_PIN_6)),
        .xor_bit = (1 << ((MCP_PORT_1 - 1) * 8 + GPIO_PIN_6)),
        .key_code_bit = (1 << 3)
    },
    {
        .bit = (1 << ((MCP_PORT_1 - 1) * 8 + GPIO_PIN_4)),
        .xor_bit = (1 << ((MCP_PORT_1 - 1) * 8 + GPIO_PIN_4)),
        .key_code_bit = (1 << 4)
    },
    {
        .bit = (1 << ((MCP_PORT_1 - 1) * 8 + GPIO_PIN_5)),
        .xor_bit = (1 << ((MCP_PORT_1 - 1) * 8 + GPIO_PIN_5)),
        .key_code_bit = (1 << 5)
    },
    {
        .bit = (1 << ((MCP_PORT_2 - 1) * 8 + GPIO_PIN_0)),
        .xor_bit = (1 << ((MCP_PORT_2 - 1) * 8 + GPIO_PIN_0)),
        .key_code_bit = (1 << 6)
    },
    {
        .bit = (1 << ((MCP_PORT_2 - 1) * 8 + GPIO_PIN_1)),
        .xor_bit = (1 << ((MCP_PORT_2 - 1) * 8 + GPIO_PIN_1)),
        .key_code_bit = (1 << 7)
    },
};

