//
// WARNING: DO NOT EDIT THIS FILE
//   This file has been generated from the target's JSON hardware description
//

#define MS_BETWEEN_CHANNEL ADC_SAMPLING_TIME_30MS
#define NUM_OF_ADS 2
static i2c_master_dev_handle_t ads[NUM_OF_ADS] = {0};

static const i2c_device_config_t i2c_dev_conf[NUM_OF_ADS] = {
  {
    .device_address = ADS1X15_ADDRESS + ADS1015_0,
    .scl_speed_hz = 400000,
  },
  {
    .device_address = ADS1X15_ADDRESS + ADS1015_1,
    .scl_speed_hz = 400000,
  },
};


static const ads1015_channel_t ads_channels[] = {
    { 1, ADS1X15_REG_CONFIG_MUX_DIFF_0_1, 4 },
    { 0, ADS1X15_REG_CONFIG_MUX_DIFF_0_1, 5 },

    { 0, ADS1X15_REG_CONFIG_MUX_DIFF_2_3, 6 },

};

