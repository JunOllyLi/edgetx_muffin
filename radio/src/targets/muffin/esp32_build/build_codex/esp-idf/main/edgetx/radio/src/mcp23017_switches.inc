//
// WARNING: DO NOT EDIT THIS FILE
//   This file has been generated from the target's JSON hardware description
//


static const mcp_switch_t _switch_defs[] = {
  {
    .name = "SA",
    .bit_high = 0,
    .bit_low = (1 << (((MCP_PORT_3 - 1) * 8) + GPIO_PIN_4)),
    .type = SWITCH_HW_2POS,
    .config = SWITCH_2POS,
    .flags = 0
  },
  {
    .name = "SB",
    .bit_high = 0,
    .bit_low = (1 << (((MCP_PORT_3 - 1) * 8) + GPIO_PIN_2)),
    .type = SWITCH_HW_2POS,
    .config = SWITCH_2POS,
    .flags = 0
  },
  {
    .name = "SC",
    .bit_high = (1 << (((MCP_PORT_2 - 1) * 8) + GPIO_PIN_2)),
    .bit_low  = (1 << (((MCP_PORT_2 - 1)* 8) + GPIO_PIN_3)),
    .type = SWITCH_HW_3POS,
    .config = SWITCH_3POS,
    .flags = 0
  },
  {
    .name = "SD",
    .bit_high = 0,
    .bit_low = (1 << (((MCP_PORT_2 - 1) * 8) + GPIO_PIN_5)),
    .type = SWITCH_HW_2POS,
    .config = SWITCH_2POS,
    .flags = 0
  },
};

static const mcp_switch_t* const _switch_offsets[] = {
  _switch_defs,
};

constexpr uint8_t n_switches = 4;
constexpr uint8_t n_fct_switches = 0;

constexpr swconfig_t _switch_default_config = (swconfig_t)0
    | ((swconfig_t)SWITCH_2POS << (0 * SW_CFG_BITS))
    | ((swconfig_t)SWITCH_2POS << (1 * SW_CFG_BITS))
    | ((swconfig_t)SWITCH_3POS << (2 * SW_CFG_BITS))
    | ((swconfig_t)SWITCH_2POS << (3 * SW_CFG_BITS))
;
